## apps/eigen_test/Kconfig
```kconfig
config EIGEN_TEST_APP
    bool "Enable Eigen Test App"
    default y
    help
       Builds an Eigen test app that tests modern Eigen with dynamic memory allocation for TinyMPC control.
```

## apps/tinympc/Kconfig
```kconfig
config TINY_MPC_CONTROLLER
    bool "Enable TinyMPC out-of-tree controller"
    default y
    help
       Builds a minimal TinyMPC-based out-of-tree controller. Currently delegates to PID for safety while scaffolding is in place.
```
